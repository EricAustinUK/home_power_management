## buildroot-ext/Config.in
```kconfig
source "$BR2_EXTERNAL_HOME_POWER_MANAGER_PATH/package/home-power-manager-d/Config.in"
```

## buildroot-ext/package/home-power-manager-d/Config.in
```kconfig
config BR2_PACKAGE_HOME_POWER_MANAGER_D
    bool 
    depends on BR2_PACKAGE_HOST_RUSTC_TARGET_ARCH_SUPPORTS
```
